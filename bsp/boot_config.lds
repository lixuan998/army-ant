MEMORY
{
    TEXT_SEG (rx) : ORIGIN = 0x40000000, LENGTH = (16 * 1024 * 1024)
    DATA_SEG (rw) : ORIGIN = (0x40000000 + (16 * 1024 * 1024)), LENGTH = (16 * 1024 * 1024)
}
BOOT_STACK_SIZE = (128 * 1024);
